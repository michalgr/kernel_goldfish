## drivers/platform/goldfish/Kconfig
```kconfig
menuconfig GOLDFISH
	bool "Platform support for Goldfish virtual devices"
	depends on X86_32 || X86_64 || ARM || ARM64 || MIPS
	---help---
	  Say Y here to get to see options for the Goldfish virtual platform.
	  This option alone does not add any kernel code.

	  Unless you are building for the Android Goldfish emulator say N here.

if GOLDFISH

config GOLDFISH_BUS
	bool "Goldfish platform bus"
	---help---
	  This is a virtual bus to host Goldfish Android Virtual Devices.

config GOLDFISH_PIPE
	tristate "Goldfish virtual device for QEMU pipes"
    depends on HAS_IOMEM
	---help---
	  This is a virtual device to drive the QEMU pipe interface used by
	  the Goldfish Android Virtual Device.

config GOLDFISH_FWDATA
	tristate "Goldfish virtual device for Android-specific firmware data"
	depends on ACPI
	---help---
	  This is a virtual device to parse Android-specific data (e.g. fstab
	  configuration) stored in firmware (e.g. ACPI tables), and present it
	  to userspace via sysfs. Currently, Android looks for some information
	  in /proc/device-tree/firmware/android/, which does not exist on
	  platforms that use ACPI instead of Device Tree, such as Goldfish
	  (Ranchu) x86/x86_64. The driver for this device creates a directory in
	  sysfs with the same layout.

endif # GOLDFISH
```

## drivers/staging/goldfish/Kconfig
```kconfig
config GOLDFISH_AUDIO
	tristate "Goldfish AVD Audio Device"
	depends on GOLDFISH && HAS_IOMEM
	---help---
	  Emulated audio channel for the Goldfish Android Virtual Device

config GOLDFISH_SYNC
    tristate "Goldfish AVD Sync Driver"
    depends on GOLDFISH && HAS_IOMEM
	---help---
	  Emulated sync fences for the Goldfish Android Virtual Device
```
